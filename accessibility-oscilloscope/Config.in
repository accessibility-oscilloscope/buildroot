## accessibility-oscilloscope/Config.in
```kconfig
source "$BR2_EXTERNAL_OSCOPE_PKGS_PATH/package/drv2605-clean/Config.in"
source "$BR2_EXTERNAL_OSCOPE_PKGS_PATH/package/oscilloscope-dump/Config.in"
source "$BR2_EXTERNAL_OSCOPE_PKGS_PATH/package/pnt-lut/Config.in"
source "$BR2_EXTERNAL_OSCOPE_PKGS_PATH/package/signal-compiler/Config.in"
source "$BR2_EXTERNAL_OSCOPE_PKGS_PATH/package/sigproc/Config.in"
```

## accessibility-oscilloscope/configs/qemu_defconfig
```kconfig
BR2_arm=y
BR2_TOOLCHAIN_BUILDROOT_GLIBC=y
BR2_TARGET_GENERIC_ISSUE="Welcome to Accessibility Oscilloscope!"
BR2_ROOTFS_DEVICE_CREATION_DYNAMIC_EUDEV=y
BR2_TARGET_GENERIC_GETTY_PORT="ttyAMA0"
BR2_ROOTFS_OVERLAY="../accessibility-oscilloscope/overlay"
BR2_ROOTFS_POST_IMAGE_SCRIPT="board/qemu/post-image.sh"
BR2_ROOTFS_POST_SCRIPT_ARGS="$(BR2_DEFCONFIG)"
BR2_LINUX_KERNEL=y
BR2_LINUX_KERNEL_CUSTOM_VERSION=y
BR2_LINUX_KERNEL_CUSTOM_VERSION_VALUE="5.10.7"
BR2_LINUX_KERNEL_USE_CUSTOM_CONFIG=y
BR2_LINUX_KERNEL_CUSTOM_CONFIG_FILE="board/qemu/arm-versatile/linux.config"
BR2_LINUX_KERNEL_DTS_SUPPORT=y
BR2_LINUX_KERNEL_INTREE_DTS_NAME="versatile-pb"
BR2_PACKAGE_PYTHON3=y
BR2_PACKAGE_PYTHON_NUMPY=y
BR2_PACKAGE_PYTHON_SERIAL=y
BR2_PACKAGE_LIBINPUT=y
BR2_TARGET_ROOTFS_EXT2=y
# BR2_TARGET_ROOTFS_TAR is not set
BR2_PACKAGE_HOST_QEMU=y
BR2_PACKAGE_HOST_QEMU_SYSTEM_MODE=y
BR2_PACKAGE_ASCII_CONV=y
BR2_PACKAGE_DRV2506_CLEAN=y
BR2_PACKAGE_PNT_LUT=y
BR2_PACKAGE_SIGNAL_COMPILER=y
BR2_PACKAGE_SIGPROC=y
```

## accessibility-oscilloscope/configs/rpi4_defconfig
```kconfig
BR2_arm=y
BR2_cortex_a72=y
BR2_ARM_FPU_NEON_VFPV4=y
BR2_TOOLCHAIN_BUILDROOT_WCHAR=y
BR2_TOOLCHAIN_BUILDROOT_CXX=y
BR2_ROOTFS_DEVICE_CREATION_DYNAMIC_EUDEV=y
BR2_SYSTEM_DHCP="eth0"
BR2_ROOTFS_OVERLAY="../accessibility-oscilloscope/overlay"
BR2_ROOTFS_POST_BUILD_SCRIPT="board/raspberrypi4/post-build.sh"
BR2_ROOTFS_POST_IMAGE_SCRIPT="board/raspberrypi4/post-image.sh"
BR2_ROOTFS_POST_SCRIPT_ARGS="--add-miniuart-bt-overlay"
BR2_LINUX_KERNEL=y
BR2_LINUX_KERNEL_CUSTOM_TARBALL=y
BR2_LINUX_KERNEL_CUSTOM_TARBALL_LOCATION="$(call github,raspberrypi,linux,967d45b29ca2902f031b867809d72e3b3d623e7a)/linux-967d45b29ca2902f031b867809d72e3b3d623e7a.tar.gz"
BR2_LINUX_KERNEL_USE_CUSTOM_CONFIG=y
BR2_LINUX_KERNEL_CUSTOM_CONFIG_FILE="../accessibility-oscilloscope/configs/rpi4_linux_defconfig"
BR2_LINUX_KERNEL_DTS_SUPPORT=y
BR2_LINUX_KERNEL_INTREE_DTS_NAME="bcm2711-rpi-4-b"
BR2_LINUX_KERNEL_NEEDS_HOST_OPENSSL=y
BR2_PACKAGE_RPI_FIRMWARE=y
BR2_PACKAGE_RPI_FIRMWARE_VARIANT_PI4=y
BR2_PACKAGE_LIBINPUT=y
BR2_TARGET_ROOTFS_EXT2=y
BR2_TARGET_ROOTFS_EXT2_4=y
BR2_TARGET_ROOTFS_EXT2_SIZE="120M"
# BR2_TARGET_ROOTFS_TAR is not set
BR2_PACKAGE_HOST_DOSFSTOOLS=y
BR2_PACKAGE_HOST_GENIMAGE=y
BR2_PACKAGE_HOST_MTOOLS=y
BR2_PACKAGE_SIGNAL_COMPILER=y
BR2_PACKAGE_OSCILLOSCOPE_DUMP=y
BR2_PACKAGE_DRV2506_CLEAN=y
BR2_PACKAGE_PNT_LUT=y
BR2_PACKAGE_ASCII_CONV=y
```

## accessibility-oscilloscope/package/ascii-conv/Config.in
```kconfig
config BR2_PACKAGE_ASCII_CONV
	bool "ascii-conv"
	help
	  converts whitespace-separated ascii representations of integers into raw integers
```

## accessibility-oscilloscope/package/drv2605-clean/Config.in
```kconfig
config BR2_PACKAGE_DRV2506_CLEAN
	bool "drv2605-clean"
	help
	  driver and inverface for DRV2605
```

## accessibility-oscilloscope/package/oscilloscope-dump/Config.in
```kconfig
config BR2_PACKAGE_OSCILLOSCOPE_DUMP
	bool "oscilloscope_dump"
	help
	  dump serial haasoscope samples.
```

## accessibility-oscilloscope/package/oscilloscope-trigger/Config.in
```kconfig
config BR2_PACKAGE_OSCILLOSCOPE_TRIGGER
	bool "oscilloscope-trigger"
	help
	  loads oscilloscope-trigger pthon file
```

## accessibility-oscilloscope/package/pnt-lut/Config.in
```kconfig
config BR2_PACKAGE_PNT_LUT
	bool "pnt-lut"
	help
	  glue to look up point in LUT with fork() + shared mem
```

## accessibility-oscilloscope/package/signal-processing/Config.in
```kconfig
config BR2_PACKAGE_SIGNAL_PROCESSING
	bool "signal-processing"
	help
	  loads signal processing python files
```

## accessibility-oscilloscope/package/sigproc/Config.in
```kconfig
config BR2_PACKAGE_SIGPROC
    bool "signal processing"
    help
      signal processing utilities
```

## oscope/package/signal-compiler/Config.in
```kconfig
config BR2_PACKAGE_SIGNAL_COMPILER
    bool "signal_compiler"
    help
      compiler signal format to PGM.
```
